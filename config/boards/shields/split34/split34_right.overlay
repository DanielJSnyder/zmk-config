// split34_right.overlay

#include "split34.dtsi"

&default_transform {
  col-offset = <6>
};

&kscan0 {
    col-gpios
        = <&pro_micro 19 GPIO_ACTIVE_HIGH> // col7
	, <&pro_micro 16 GPIO_ACTIVE_HIGH> // col8
	, <&pro_micro 14 GPIO_ACTIVE_HIGH> // col9
	, <&pro_micro 15 GPIO_ACTIVE_HIGH> // col10
	, <&pro_micro 18 GPIO_ACTIVE_HIGH> // col11
	, <&pro_micro 8 GPIO_ACTIVE_HIGH> // col12
	, <&pro_micro 6 GPIO_ACTIVE_HIGH> // col13
	;
    row-gpios
        = <&pro_micro 21 (GPIO_ACTIVE_HIGH | GPIO_PULL_DOWN)> // row0 (row5 in schematic)
        , <&pro_micro 20 (GPIO_ACTIVE_HIGH | GPIO_PULL_DOWN)> // row1 (row6 in schematic)
        , <&pro_micro 10 (GPIO_ACTIVE_HIGH | GPIO_PULL_DOWN)> // row2 (row7 in schematic)
        , <&pro_micro 9 (GPIO_ACTIVE_HIGH | GPIO_PULL_DOWN)> // row3 (row8 in schematic)
        , <&pro_micro 7 (GPIO_ACTIVE_HIGH | GPIO_PULL_DOWN)> // row4 (row9 in schematic)
	;
};
